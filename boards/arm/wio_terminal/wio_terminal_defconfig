## boards/arm/wio_terminal/wio_terminal_defconfig
```kconfig
#
# Copyright (c) 2021 Szymon Duchniewicz
# 
# SPDX-License-Identifier: Apache-2.0
#

# Soc/board specific
CONFIG_SOC_SERIES_SAMD51=y
CONFIG_SOC_PART_NUMBER_SAMD51P19A=y
CONFIG_BOARD_WIO_TERMINAL=y
CONFIG_SOC_ATMEL_SAMD5X_OSCULP32K_AS_MAIN=y

CONFIG_CORTEX_M_SYSTICK=y
CONFIG_ARM_MPU=y
CONFIG_HW_STACK_PROTECTION=y

# Bootloader
CONFIG_BOOTLOADER_BOSSA=y
CONFIG_BOOTLOADER_BOSSA_ADAFRUIT_UF2=y

CONFIG_PINMUX=y
CONFIG_GPIO=y
CONFIG_SERIAL=y

CONFIG_USB_CDC_ACM=y
# Enable console
CONFIG_CONSOLE=y
CONFIG_UART_CONSOLE=y
CONFIG_UART_INTERRUPT_DRIVEN=y

#CONFIG_USB_DEVICE_STACK=y
#CONFIG_UART_LINE_CTRL=y
#CONFIG_SHELL_BACKEND_SERIAL_INIT_PRIORITY=51



#CONFIG_USB_DEVICE_STACK=y
#CONFIG_USB_DEVICE_PRODUCT="Zephyr USB shell sample"
#CONFIG_USB_UART_CONSOLE=y
#CONFIG_SHELL_BACKEND_SERIAL_CHECK_DTR=y
#CONFIG_UART_LINE_CTRL=y
#CONFIG_SHELL_BACKEND_SERIAL_INIT_PRIORITY=51
#
#To consider: CONFIG_UART_SAM0 (enables SERCOMx USART driver for Atmel SAM0 MCUs, CONFIG_GPIO_SAM0
```
